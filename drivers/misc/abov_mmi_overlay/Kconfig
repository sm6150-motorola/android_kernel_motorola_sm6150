## drivers/misc/abov_mmi_overlay/Kconfig
```kconfig
config INPUT_ABOV_MMI_OVERLAY
        tristate "INPUT_ABOV_MMI_OVERLAY_sensor"
        depends on I2C
        default n
        help
          Say Y to enable the SAR detection application, if N here not to use the
          this SAR sensor

config CAPSENSE_HEADSET_STATE
	bool "Enable cap-sensor headset state"
	depends on INPUT_ABOV_MMI_OVERLAY
	help
	  Enable Cap-sensor headset state.
```

## drivers/misc/tps61280/Kconfig
```kconfig
config REGULATOR_TPS61280
        tristate "TI TPS61280 Power Regulator"
        depends on I2C
        select REGMAP_I2C
        help
          This driver supports TPS61280 voltage regulator chip. This
          regulator is meant for modem power supply. This chip is
          high-frequency synchronous step-up dc-dc converter optimized
          for battery-powered portable applications.
```

## drivers/pinctrl/cirrus/Kconfig
```kconfig
# This is all selected by the Madera MFD driver Kconfig options
config PINCTRL_MADERA
	tristate
	select PINMUX
	select GENERIC_PINCONF
```
